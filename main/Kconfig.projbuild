## main/Kconfig.projbuild
```kconfig
menu "Example Configuration"

config WIFI_SSID
    string "WiFi SSID"
	default "myssid"
	help
		SSID (network name) for the example to connect to.

config WIFI_PASSWORD
    string "WiFi Password"
	default "myssid"
	help
		WiFi password (WPA or WPA2) for the example to use.

		Can be left blank if the network has no security set.

config SERVER
    string "Default Server"
	default "s3.amazonaws.com"
	help
		HTTP Server to download the image file from.

		See example README.md for details.

config FILENAME
	string "HTTP GET Filename"
	default "/filepath/firmware.bin"
	help
		Filename and filepath of the app image file to download for
		the OTA update.

endmenu
```
